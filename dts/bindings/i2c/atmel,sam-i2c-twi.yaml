## dts/bindings/i2c/atmel,sam-i2c-twi.yaml
```yaml
# Copyright (c) 2017 Piotr Mienkowski
# SPDX-License-Identifier: Apache-2.0

description: Atmel SAM Family I2C (TWI) node

compatible: "atmel,sam-i2c-twi"

include:
  - name: i2c-controller.yaml
  - name: pinctrl-device.yaml

properties:
  reg:
    required: true

  interrupts:
    required: true

  clocks:
    required: true

  scl-gpios:
    type: phandle-array
    description: |
      GPIO to which the I2C SCL signal is routed. This is only needed for I2C bus recovery
      support.

  sda-gpios:
    type: phandle-array
    description: |
      GPIO to which the I2C SDA signal is routed. This is only needed for I2C bus recovery
      support.
```

## dts/bindings/sensor/memsic,mc3419-spi.yaml
```yaml
# SPDX-License-Identifier: Apache-2.0
# Copyright (c) 2023 Linumiz

description: MC3419 3-axis accel sensor

compatible: "memsic,mc3419"

include: [memsic,mc3419.yaml, i2c-device.yaml]
```
